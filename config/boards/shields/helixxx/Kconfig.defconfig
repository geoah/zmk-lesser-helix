## config/boards/shields/helixxx/Kconfig.defconfig
```kconfig
# Copyright (c) 2020 The ZMK Contributors
# SPDX-License-Identifier: MIT

if SHIELD_HELIXXX_LEFT

config ZMK_KEYBOARD_NAME
    default "Helixxx"

config ZMK_SPLIT_ROLE_CENTRAL
    default y

endif

if SHIELD_HELIXXX_LEFT || SHIELD_HELIXXX_RIGHT

config ZMK_SPLIT
    default y

endif
```

## config/boards/shields/helixxx/Kconfig.shield
```kconfig
# Copyright (c) 2020 The ZMK Contributors
# SPDX-License-Identifier: MIT

config SHIELD_HELIXXX_LEFT
    def_bool $(shields_list_contains,helixxx_left)

config SHIELD_HELIXXX_RIGHT
    def_bool $(shields_list_contains,helixxx_right)
```
